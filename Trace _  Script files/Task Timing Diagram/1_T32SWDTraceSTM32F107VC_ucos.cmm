;========================================================================
; Praktikum Mikrocomputertechnik / Real-Time Systems Lab 2015
;
; Lauterbach TRACE32 Debugger-Configuration for STM32F107VC
; ITM-Debug/Trace via Serial Wire Debug Port (SWD)
;
; To be used in conjunction with 2_T32TraceStart.cmm, then
; 3_T32TraceShowStatistics.cmm and/or 3_T32TraceShowTaskTiming.cmm, then
; 4_T32TraceSave.cmm           and/or 5_T32TraceLoad.cmm
;
; SPECIAL FEATURES:
; "stop by vcatch" for UNDEFINSTR & DIVBYZERO exceptions ..... DISABLED
; µC/OS-awareness in main menu bar ........................... ENABLED
; ITM.DataTrace .............................................. ENABLED
;
; 141201 mys - modification  "SYStem.Down"  state after flash programming
; 150827 mys - g OS_CPU_SysTickInit before trace start, clear old breakpoints
;========================================================================

; STM32F107VC memory locations
&FlashStart=0x08000000
&RAMStart=0x20000000
&FlashSize=256.
&RAMSize=64.

;========================================================================
; Setup Screen / Windows structure

DO T32WinConfig

;========================================================================
; CPU setup

print "CPU = STM32F107VC via SWD-Port"
SYStem.RESet
SYStem.CPU STM32F107VC
SYStem.CONFIG SWDP ON       ; debugging/trace via
                            ; Serial Wire Debug Port
SYStem.Up
Break.DELETE /ALL           ; clear all old trace breakpoints

;========================================================================
; Flash declaration & programming

GOSUB FlashProgram

SYStem.Down                 ; reset device after flash programming

SYStem.CONFIG SWDP ON       ; debugging/trace via SWD
SYStem.Up

;========================================================================
; setup ITM Trace via TPIU == see ITM.state

;;ETM.OFF                ; if ETM NOT available 
;;ITM.state              ; see p. 23 of doc "CombiProbe_Cortexm.pdf"

ITM.OFF                  ; disable for now, start for trace after Init()
ITM.PortSize SWV         ; for SWD
ITM.PortMode NRZ/2       ; for SWD   72MHz/2 = 36MHz
CAnalyzer.THreshold 1.65

;;print "Autodetecting ExportClock ..." 
;;CAnalyzer.AutoFocus  ; or: set known clockfreq via CAnalyzer.ExportCLOCK

print "Set CAnalyzer.ExportClock = 36MHz" 
CAnalyzer.ExportClock 36MHz
;;print "Set CAnalyzer.CLOCK = 72MHz"
;;CAnalyzer.Clock 72MHz 

ITM.DataTrace DataPC
;;ITM.InteruptTrace ON
;;ITM.PCSampler 1/64              ; gives HARDERRORS w ReadBMS_150901
ITM.PCSampler 1/128

; initialize OS awareness
print "Initializing uC/OS awareness"
TASK.CONFIG ucos                  ; load ucos awareness (ucos.t32)
MENU.ReProgram ucos               ; load ucos specific menu (ucos.men)

;;print "Run to main()"
;;g main

;;print "Run to OSStart()"
;;g OSStart

print "Run to OS_SysTick<Init()"
g OS_CPU_SysTickInit

ENDDO


FlashProgram:
;========================================================================
; Flash declaration

FLASH.RESet

if &FlashSize>=256.
(
  FLASH.Create 1. &FlashStart++((0x400*&FlashSize)-0x01) 0x800 TARGET Word
)
else
(
  FLASH.Create 1. &FlashStart++((0x400*&FlashSize)-0x01) 0x400 TARGET Word
)

if &RAMSize>=6.
(
  FLASH.TARGET &RAMStart  (&RAMStart+0x1000) 0x1000 stm32.bin
;;FLASH.TARGET &RAMStart  (&RAMStart+0x0c00) 0x0800 stm32.bin
;;FLASH.TARGET 0x20000000 0x20001000         0x1000 stm32.bin
)
else
(
  dialog.OK "Not enough RAM for flash algorithm."
  enddo
)

;**FLASH.List
;========================================================================
; Flash programming
;
DIALOG.YESNO "(Re-) Program flash memory ?"
LOCAL &progflash
ENTRY &progflash

IF &progflash 
(
; Activate flash driver
  FLASH.ReProgram ALL    ; /Erase
  
;;Setup erased flash values
;;Data.Set &FlashStart++((0x400*&FlashSize)-0x01) %Long 0xffffffff
  
; Download a file 
  Data.LOAD.auto \obj\*.axf
  
; Erase and program modified sectors
  FLASH.ReProgram OFF
  
;;Verify flash programming
;;Data.LOAD.auto \obj\*.axf /ComPare

  print "Flash programming SUCCESSFUL !"
)
RETURN

